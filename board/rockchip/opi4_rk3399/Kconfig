## board/rockchip/opi4_rk3399/Kconfig
```kconfig
if TARGET_OPI4_RK3399

config ANDROID_BOOT
	bool "Support Android 13 boot"
	default y

config SYS_BOARD
	default "opi4_rk3399"

config SYS_VENDOR
	default "rockchip"

config SYS_CONFIG_NAME
	default "opi4_rk3399"

endif
```
